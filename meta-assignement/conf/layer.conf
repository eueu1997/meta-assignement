## meta-assignement/conf/layer.conf
```bitbake
# We have a conf and classes directory, add to BBPATH
BBPATH .= ":${LAYERDIR}"

# We have recipes-* directories, add to BBFILES
BBFILES += "${LAYERDIR}/recipes-*/*/*.bb \
            ${LAYERDIR}/recipes-*/*/*.bbappend"

BBFILE_COLLECTIONS += "meta-assignement"
BBFILE_PATTERN_meta-assignement = "^${LAYERDIR}/"
BBFILE_PRIORITY_meta-assignement = "6"

LAYERDEPENDS_meta-assignement = "core"
LAYERSERIES_COMPAT_meta-assignement = "dunfell"
```
